## boards/arm/mgair_v3/Kconfig.defconfig
```kconfig
if BOARD_MGAIR_V3

config HW_STACK_PROTECTION
	default ARCH_HAS_STACK_PROTECTION

endif
```

## boards/arm/mgair_v3/board.yml
```yaml
board:
  name: mgair_v3
  full_name: MioGiapicco Air v3
  vendor: dawidkulpa
  socs:
  - name: nrf52840
```

## boards/arm/mgair_v3/mgair_v3_defconfig
```kconfig
# SPDX-License-Identifier: Apache-2.0

# Enable MPU
CONFIG_ARM_MPU=y

# enable GPIO
CONFIG_GPIO=y

# enable uart driver
CONFIG_SERIAL=y

# enable console
CONFIG_CONSOLE=y
CONFIG_UART_CONSOLE=y


CONFIG_CLOCK_CONTROL_NRF_K32SRC_RC=y
CONFIG_CLOCK_CONTROL_NRF_K32SRC_XTAL=n
CONFIG_CLOCK_CONTROL_NRF_K32SRC_SYNTH=n
CONFIG_NRF_APPROTECT_USE_UICR=y
CONFIG_NRF_APPROTECT_LOCK=n
```

## build/Kconfig/arch/Kconfig
```kconfig
# Load Zephyr Arch Kconfig descriptions.
osource "/home/dkulpa/ToolBox/projects/MioGiapicco/Software/firmwares/mgairfw-zephyr-workspace/zephyr/arch/rx/Kconfig"
osource "/home/dkulpa/ToolBox/projects/MioGiapicco/Software/firmwares/mgairfw-zephyr-workspace/zephyr/arch/x86/Kconfig"
osource "/home/dkulpa/ToolBox/projects/MioGiapicco/Software/firmwares/mgairfw-zephyr-workspace/zephyr/arch/xtensa/Kconfig"
osource "/home/dkulpa/ToolBox/projects/MioGiapicco/Software/firmwares/mgairfw-zephyr-workspace/zephyr/arch/sparc/Kconfig"
osource "/home/dkulpa/ToolBox/projects/MioGiapicco/Software/firmwares/mgairfw-zephyr-workspace/zephyr/arch/riscv/Kconfig"
osource "/home/dkulpa/ToolBox/projects/MioGiapicco/Software/firmwares/mgairfw-zephyr-workspace/zephyr/arch/posix/Kconfig"
osource "/home/dkulpa/ToolBox/projects/MioGiapicco/Software/firmwares/mgairfw-zephyr-workspace/zephyr/arch/mips/Kconfig"
osource "/home/dkulpa/ToolBox/projects/MioGiapicco/Software/firmwares/mgairfw-zephyr-workspace/zephyr/arch/arm64/Kconfig"
osource "/home/dkulpa/ToolBox/projects/MioGiapicco/Software/firmwares/mgairfw-zephyr-workspace/zephyr/arch/arm/Kconfig"
osource "/home/dkulpa/ToolBox/projects/MioGiapicco/Software/firmwares/mgairfw-zephyr-workspace/zephyr/arch/arc/Kconfig"
```

## build/Kconfig/boards/Kconfig
```kconfig
# Load Zephyr board Kconfig descriptions.
osource "/home/dkulpa/ToolBox/projects/MioGiapicco/Software/firmwares/mgairfw-zephyr-workspace/zephyr/boards/dawidkulpa/mgair_v3/Kconfig"
```

## build/Kconfig/boards/Kconfig.mgair_v3
```kconfig
# Load board Kconfig descriptions.
osource "/home/dkulpa/ToolBox/projects/MioGiapicco/Software/firmwares/mgairfw-zephyr-workspace/zephyr/boards/dawidkulpa/mgair_v3/Kconfig.mgair_v3"
```

## build/Kconfig/boards/Kconfig.sysbuild
```kconfig
# Load Sysbuild board Kconfig descriptions.
osource "/home/dkulpa/ToolBox/projects/MioGiapicco/Software/firmwares/mgairfw-zephyr-workspace/zephyr/boards/dawidkulpa/mgair_v3/Kconfig.sysbuild"
```
